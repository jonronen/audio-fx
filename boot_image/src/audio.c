#include "stmp3xxx.h"

static void imx233_reset_audioin(void)
{
    /* soft-reset */
    HW_AUDIOIN_CTRL_SET(BM_AUDIOIN_CTRL_SFTRST);
    /* make sure block is gated off */
    while(!(HW_AUDIOIN_CTRL_RD() & BM_AUDIOIN_CTRL_CLKGATE));
    /* bring block out of reset */
    HW_AUDIOIN_CTRL_CLR(BM_AUDIOIN_CTRL_SFTRST);
    while(HW_AUDIOIN_CTRL_RD() & BM_AUDIOIN_CTRL_SFTRST);
    /* make sure clock is running */
    HW_AUDIOIN_CTRL_CLR(BM_AUDIOIN_CTRL_CLKGATE);
    while(HW_AUDIOIN_CTRL_RD() & BM_AUDIOIN_CTRL_CLKGATE);
}

static void imx233_reset_audioout(void)
{
    /* soft-reset */
    HW_AUDIOOUT_CTRL_SET(BM_AUDIOOUT_CTRL_SFTRST);
    /* make sure block is gated off */
    while(!(HW_AUDIOOUT_CTRL_RD() & BM_AUDIOOUT_CTRL_CLKGATE));
    /* bring block out of reset */
    HW_AUDIOOUT_CTRL_CLR(BM_AUDIOOUT_CTRL_SFTRST);
    while(HW_AUDIOOUT_CTRL_RD() & BM_AUDIOOUT_CTRL_SFTRST);
    /* make sure clock is running */
    HW_AUDIOOUT_CTRL_CLR(BM_AUDIOOUT_CTRL_CLKGATE);
    while(HW_AUDIOOUT_CTRL_RD() & BM_AUDIOOUT_CTRL_CLKGATE);
}

void fx_audio_init(void)
{
    imx233_reset_audioout();
    imx233_reset_audioin();

    /* Set the audio recorder to use LRADC1, and set to an 8K resistor. */
    HW_AUDIOIN_MICLINE_WR(0x00000001);

    HW_AUDIOIN_CTRL_CLR(BM_AUDIOIN_CTRL_FIFO_OVERFLOW_IRQ);
    HW_AUDIOIN_CTRL_CLR(BM_AUDIOIN_CTRL_FIFO_UNDERFLOW_IRQ);
    HW_AUDIOIN_CTRL_SET(BM_AUDIOIN_CTRL_FIFO_ERROR_IRQ_EN);
    HW_AUDIOIN_CTRL_SET(BM_AUDIOIN_CTRL_OFFSET_ENABLE);
    HW_AUDIOIN_CTRL_SET(BM_AUDIOIN_CTRL_HPF_ENABLE);

    HW_AUDIOOUT_CTRL_CLR(BM_AUDIOOUT_CTRL_FIFO_OVERFLOW_IRQ);
    HW_AUDIOOUT_CTRL_CLR(BM_AUDIOOUT_CTRL_FIFO_UNDERFLOW_IRQ);
    HW_AUDIOOUT_CTRL_SET(BM_AUDIOOUT_CTRL_FIFO_ERROR_IRQ_EN);

    // set the frequencies to 44.1KHz
    HW_AUDIOIN_ADCSRR_WR(0x10110037);
    HW_AUDIOOUT_DACSRR_WR(0x10110037);

    HW_AUDIOIN_CTRL_SET(0x001f0000);
    HW_AUDIOOUT_CTRL_SET(0x001f0000);
    HW_AUDIOIN_ADCVOL_WR(0x00000202);
    HW_AUDIOIN_ADCVOLUME_WR(0x00db00db);
    HW_AUDIOOUT_DACVOLUME_WR(0x00ff00ff);

    /* Set word-length to 32-bit */
    HW_AUDIOOUT_CTRL_CLR(BM_AUDIOOUT_CTRL_WORD_LENGTH);
    HW_AUDIOIN_CTRL_CLR(BM_AUDIOIN_CTRL_WORD_LENGTH);
    /* Set frequencies to 44.1KHz */
    HW_AUDIOIN_ADCSRR_WR(0x10110037);
    HW_AUDIOOUT_DACSRR_WR(0x10110037);
    /* Enable DAC and ADC */
    HW_AUDIOOUT_ANACLKCTRL_CLR(BM_AUDIOOUT_ANACLKCTRL_CLKGATE);
    HW_AUDIOIN_ANACLKCTRL_CLR(BM_AUDIOIN_ANACLKCTRL_CLKGATE);
    /* set the diethering. they say it improves quality */
    HW_AUDIOIN_ANACLKCTRL_CLR(BM_AUDIOIN_ANACLKCTRL_DITHER_OFF);
    /* Hold HP to ground to avoid pop, then release and power up stuff */
    HW_AUDIOOUT_ANACTRL_SET(BM_AUDIOOUT_ANACTRL_HP_HOLD_GND);
    HW_RTC_PERSISTENT0_SET(0x00080000);

    /* Power up DAC, ADC, speaker, and headphones */
    HW_AUDIOOUT_PWRDN_CLR(BM_AUDIOOUT_PWRDN_DAC);
    HW_AUDIOOUT_PWRDN_CLR(BM_AUDIOOUT_PWRDN_ADC);
    HW_AUDIOOUT_PWRDN_CLR(BM_AUDIOOUT_PWRDN_SPEAKER);
    HW_AUDIOOUT_PWRDN_CLR(BM_AUDIOOUT_PWRDN_HEADPHONE);
    /* release HP from ground */
    HW_RTC_PERSISTENT0_CLR(0x00080000);

    /* Set HP mode to AB */
    HW_AUDIOOUT_ANACTRL_SET(BM_AUDIOOUT_ANACTRL_HP_CLASSAB);
    /* Stop holding to ground */
    HW_AUDIOOUT_ANACTRL_CLR(BM_AUDIOOUT_ANACTRL_HP_HOLD_GND);

    HW_AUDIOOUT_HPVOL_CLR(BM_AUDIOOUT_HPVOL_MUTE);
    HW_AUDIOOUT_HPVOL_CLR(0x0000FFFF);
    HW_AUDIOOUT_SPEAKERCTRL_SET(BM_AUDIOOUT_SPEAKERCTRL_MUTE);

    // write some shit to the data to make sure it's not stuck
    HW_AUDIOOUT_DATA_WR(0x00000000);
    udelay(200);
    HW_AUDIOOUT_DATA_WR(0x00000001);
    udelay(200);
}

